## CMakeLists.txt
```
# SPDX-License-Identifier: Apache-2.0


cmake_minimum_required(VERSION 3.20.0)
find_package(Zephyr REQUIRED HINTS $ENV{ZEPHYR_BASE})
project(peripheral_sc_only)

target_sources(app PRIVATE
  src/main.c
)



#
# Copyright (c) 2021 Nordic Semiconductor ASA
#
# SPDX-License-Identifier: Apache-2.0
#


cmake_minimum_required(VERSION 3.20.0)

find_package(Zephyr REQUIRED HINTS $ENV{ZEPHYR_BASE})

get_target_property(TFM_BINARY_DIR tfm TFM_BINARY_DIR)
configure_file(
  ${CMAKE_CURRENT_LIST_DIR}/dummy_partition/tfm_manifest_list.yaml.in
  ${CMAKE_CURRENT_BINARY_DIR}/dummy_partition/tfm_manifest_list.yaml
)

set_property(TARGET zephyr_property_target
  APPEND PROPERTY TFM_CMAKE_OPTIONS
  -DTFM_EXTRA_MANIFEST_LIST_FILES=${CMAKE_CURRENT_BINARY_DIR}/dummy_partition/tfm_manifest_list.yaml
  -DTFM_EXTRA_PARTITION_PATHS=${CMAKE_CURRENT_LIST_DIR}/dummy_partition
)

project(tfm_secure_partition)

target_sources(app PRIVATE
  src/main.c
  src/BLE_partition.c #dummy
)

target_include_directories(app PRIVATE
  $<TARGET_PROPERTY:tfm,TFM_BINARY_DIR>/api_ns/interface/include
)

target_compile_definitions(app
    PRIVATE TFM_PARTITION_DUMMY_PARTITION
)



############################ Partition Defs ####################################
```

## prj.conf
```kconfig
# Uncomment the following two options to get thread stack usage logs
#CONFIG_INIT_STACKS=y
#CONFIG_THREAD_STACK_INFO=y

CONFIG_BT=y
CONFIG_LOG=y
CONFIG_BT_PERIPHERAL=y
CONFIG_BT_SMP=y
CONFIG_BT_SMP_SC_ONLY=y  # <-- Uncommented for Passkey mode (comment out for Just Works testing)
CONFIG_BT_MAX_PAIRED=2
CONFIG_BT_DEVICE_NAME="SC only peripheral"



#jasmine
CONFIG_BUILD_WITH_TFM=y
CONFIG_TFM_PROFILE_TYPE_NOT_SET=y
CONFIG_TFM_CONNECTION_BASED_SERVICE_API=y
CONFIG_UART_CONSOLE=y
CONFIG_PRINTK=y
CONFIG_STDOUT_CONSOLE=y
CONFIG_LOG=y

# Note: TF-M secure partition logging is managed by TF-M build system,
# not Zephyr Kconfig. Secure partition printf() may not appear in output.

#jasmine
```

## src/main.c
```c
#include <zephyr/types.h>
#include <stddef.h>
#include <string.h>
#include <errno.h>
#include <zephyr/sys/printk.h>
#include <zephyr/sys/byteorder.h>
#include <zephyr/kernel.h>

#include <zephyr/bluetooth/bluetooth.h>
#include <zephyr/bluetooth/hci.h>
#include <zephyr/bluetooth/conn.h>
#include <zephyr/bluetooth/uuid.h>
#include <zephyr/bluetooth/gatt.h>
#include <zephyr/kernel.h>
#include <psa/crypto.h>


#include "BLE_partition.h"
#include <zephyr/logging/log.h>
LOG_MODULE_REGISTER(main);

// Timer for measuring pairing overhead
static int64_t pairing_start_time = 0;
static int64_t pairing_end_time = 0;




//jasmine

// Include the header for secure partition (TF-M)
// #include "tfm_api.h"

//jasmine

static const struct bt_data ad[] = {
	BT_DATA_BYTES(BT_DATA_FLAGS, (BT_LE_AD_GENERAL | BT_LE_AD_NO_BREDR)),
};

static const struct bt_data sd[] = {
	BT_DATA(BT_DATA_NAME_COMPLETE, CONFIG_BT_DEVICE_NAME, sizeof(CONFIG_BT_DEVICE_NAME) - 1),
};

static void start_adv(void)
{
	int err;

	err = bt_le_adv_start(BT_LE_ADV_CONN_FAST_1, ad, ARRAY_SIZE(ad), sd, ARRAY_SIZE(sd));
	if (err) {
		printk("Advertising failed to start (err %d)\n", err);
	} else {
		printk("Advertising successfully started\n");
	}
}

static void connected(struct bt_conn *conn, uint8_t err)
{
	char addr[BT_ADDR_LE_STR_LEN];

	bt_addr_le_to_str(bt_conn_get_dst(conn), addr, sizeof(addr));

	if (err) {
		printk("Failed to connect to %s %u %s\n", addr, err, bt_hci_err_to_str(err));
		return;
	}

	printk("Connected %s\n", addr);

	// Start timing for pairing overhead measurement
	pairing_start_time = k_uptime_get();
	printk("[TIMER] Pairing started at: %lld ms\n", pairing_start_time);

	// Security level selection:
	// L2 = Just Works (unauthenticated, for timing tests)
	// L4 = Passkey Display (authenticated, for demo)
	// if (bt_conn_set_security(conn, BT_SECURITY_L2)) {  // <-- Use L2 for Just Works
	if (bt_conn_set_security(conn, BT_SECURITY_L4)) {  // <-- Use L4 for Passkey mode
		printk("Failed to set security\n");
	}
}

static void disconnected(struct bt_conn *conn, uint8_t reason)
{
	char addr[BT_ADDR_LE_STR_LEN];

	bt_addr_le_to_str(bt_conn_get_dst(conn), addr, sizeof(addr));

	printk("Disconnected from %s, reason 0x%02x %s\n", addr,
	       reason, bt_hci_err_to_str(reason));
}

static void identity_resolved(struct bt_conn *conn, const bt_addr_le_t *rpa,
			      const bt_addr_le_t *identity)
{
	char addr_identity[BT_ADDR_LE_STR_LEN];
	char addr_rpa[BT_ADDR_LE_STR_LEN];

	bt_addr_le_to_str(identity, addr_identity, sizeof(addr_identity));
	bt_addr_le_to_str(rpa, addr_rpa, sizeof(addr_rpa));

	printk("Identity resolved %s -> %s\n", addr_rpa, addr_identity);
}

static void security_changed(struct bt_conn *conn, bt_security_t level,
			     enum bt_security_err err)
{
	char addr[BT_ADDR_LE_STR_LEN];

	bt_addr_le_to_str(bt_conn_get_dst(conn), addr, sizeof(addr));

	if (!err) {
		printk("Security changed: %s level %u\n", addr, level);
	} else {
		printk("Security failed: %s level %u err %s(%d)\n", addr, level,
		       bt_security_err_to_str(err), err);
	}
}

BT_CONN_CB_DEFINE(conn_callbacks) = {
	.connected = connected,
	.disconnected = disconnected,
	.recycled = start_adv,
	.identity_resolved = identity_resolved,
	.security_changed = security_changed,
};

static void auth_passkey_display(struct bt_conn *conn, unsigned int passkey)
{
	char addr[BT_ADDR_LE_STR_LEN];

	bt_addr_le_to_str(bt_conn_get_dst(conn), addr, sizeof(addr));

	printk("Passkey for %s: %06u\n", addr, passkey);
}

static void auth_cancel(struct bt_conn *conn)
{
	char addr[BT_ADDR_LE_STR_LEN];

	bt_addr_le_to_str(bt_conn_get_dst(conn), addr, sizeof(addr));

	printk("Pairing cancelled: %s\n", addr);
}

static void pairing_complete(struct bt_conn *conn, bool bonded)
{
	// Stop timing and calculate pairing duration
	pairing_end_time = k_uptime_get();
	int64_t pairing_duration = pairing_end_time - pairing_start_time;

	printk("Pairing Complete\n");
	printk("========================================\n");
	printk("[TIMER] Pairing ended at: %lld ms\n", pairing_end_time);
	printk("[TIMER] TOTAL PAIRING TIME: %lld ms\n", pairing_duration);
	printk("========================================\n");
}

static void pairing_failed(struct bt_conn *conn, enum bt_security_err reason)
{
	printk("Pairing Failed (%d). Disconnecting.\n", reason);
	bt_conn_disconnect(conn, BT_HCI_ERR_AUTH_FAIL);
}

static struct bt_conn_auth_cb auth_cb_display = {
	// ===== PAIRING MODE SELECTION =====
	// Just Works mode (automatic pairing, for timing tests):
	// .passkey_display = NULL,

	// Passkey Display mode (shows passkey on device, for demo):
	.passkey_display = auth_passkey_display,  // <-- Uncomment for passkey mode
	// ==================================

	.passkey_entry = NULL,
	.cancel = auth_cancel,
};

static struct bt_conn_auth_info_cb auth_cb_info = {
	.pairing_complete = pairing_complete,
	.pairing_failed = pairing_failed,
};

int main(void)
{
	int err;

	err = bt_enable(NULL);
	if (err) {
		printk("Bluetooth init failed (err %d)\n", err);
		return 0;
	}

	printk("Bluetooth initialized\n");

	bt_conn_auth_cb_register(&auth_cb_display);
	bt_conn_auth_info_cb_register(&auth_cb_info);


	start_adv();

	
	uint8_t digest[32];

	for (int key = 0; key < 6; key++) {
		psa_status_t status = dp_secret_digest(key, digest, sizeof(digest));

		if (status == PSA_ERROR_INVALID_ARGUMENT && key == 5) {
			
			printk("No valid secret for key, received expected error code\n");
		} else if (status != PSA_SUCCESS) {
			printk("Status: %d\n", status);
		} else {
			printk("Digest: ");
			for (int i = 0; i < 32; i++) {
				printk("%02x", digest[i]);
			}
			printk("\n");
		}
	}

	LOG_INF("yoooooooo");
	k_sleep(K_MSEC(100)); // small delay to let UART flush
	/////////////////////jasmineeeeeeeeeeeee-add-this-for-HI I AM JASMINE I LIKE PIZZA
	char hi_msg[64] = {0};
if (dp_jas_hi(hi_msg, sizeof(hi_msg)) == PSA_SUCCESS) // Call the dp_jas_hi wrapper (IPC to the secure partition) and check if it succeeds
{
	LOG_INF("Secure says: %s", hi_msg);

} else {
    LOG_INF("Secure call to Jasmine failed!\n");
}
	/////////////////////////////until here
	return 0;
	
}
```

## src/BLE_partition.c
```c
#include <tfm_ns_interface.h>   // Provides interface for non-secure applications to call secure services
#include "BLE_partition.h"      // Header file for the BLE (dummy) secure partition
#include <stdbool.h>      // for bool
#include <zephyr/sys/slist.h>  // for sys_snode_t
#if defined(CONFIG_TFM_IPC)     // Compile this block only if Inter-Process Communication (IPC) is enabled
#include "psa/client.h"         // PSA client API used to communicate with secure partitions
#include "psa_manifest/sid.h"   // Contains Service IDs (SIDs) and versions for secure services
#include <string.h>
#include "psa/crypto.h"

#define TFN_PUBKEY_EXPORT_LEN 65  // 0x04 prefix + 64-byte X/Y coordinates for secp256r1


//keygen



//adding more than one private key
// psa_status_t dp_ble_keygen(uint8_t *out_buf, size_t buf_size, size_t *actual_export_len)
// {
//     psa_status_t status;
//     psa_handle_t handle;

//     psa_outvec out_vec[] = {
//         { .base = out_buf, .len = buf_size }
//     };

//     // handle = psa_connect(TFM_BLE_KEYGEN_SID, TFM_BLE_KEYGEN_VERSION);
//     handle = psa_connect(TFM_BLE_KEYGEN_SERVICE_SID,
//         TFM_BLE_KEYGEN_SERVICE_VERSION);

//     if (!PSA_HANDLE_IS_VALID(handle)) {
//         return PSA_ERROR_GENERIC_ERROR;
//     }

//     status = psa_call(handle, PSA_IPC_CALL, NULL, 0, out_vec, 1);

//       if (status == PSA_SUCCESS && actual_export_len) {
//         /* out_vec[0].len contains number of bytes written by secure partition */
//         /* We return the length of the exported public key only (excluding key_id) */
//         if (out_vec[0].len >= sizeof(psa_key_id_t)) {
//             *actual_export_len = out_vec[0].len - sizeof(psa_key_id_t);
//         } else {
//             *actual_export_len = 0;
//         }
//     }

//     psa_close(handle);
//     return status;
// }
//adding more than one private key

// KEYGEN now returns private_key_id instead of slot_index
  struct keygen_output {
      psa_key_id_t private_key_id;
      uint8_t pubkey[65];  // TFN_PUBKEY_EXPORT_LEN
  };

  psa_status_t dp_ble_keygen(psa_key_id_t *private_key_id_out,
                             uint8_t *pub_key_out,
                             size_t *actual_export_len)
  {
      psa_status_t status;
      psa_handle_t handle;
      struct keygen_output output;

      psa_outvec out_vec[] = {
          { .base = &output, .len = sizeof(output) }
      };

      handle = psa_connect(TFM_BLE_KEYGEN_SERVICE_SID,
                           TFM_BLE_KEYGEN_SERVICE_VERSION);
      if (!PSA_HANDLE_IS_VALID(handle)) {
          return PSA_ERROR_GENERIC_ERROR;
      }

      // No input needed - just call to generate key
      status = psa_call(handle, PSA_IPC_CALL, NULL, 0, out_vec, 1);

      if (status == PSA_SUCCESS) {
          *private_key_id_out = output.private_key_id;
          memcpy(pub_key_out, output.pubkey, 65);
          if (actual_export_len) {
              *actual_export_len = 65;
          }
      }

      psa_close(handle);
      return status;
  }
//until here for adding more than one private keys




//keygen


/* Wrapper for Secret Digest Service */
psa_status_t dp_secret_digest(uint32_t secret_index,
             void *p_digest,
             size_t digest_size)
{
    psa_status_t status;        // Variable to store the result of PSA calls
    psa_handle_t handle;        // Handle used to connect to a secure service

    psa_invec in_vec[] = {      // Input vector: data to be sent to the secure service
        { .base = &secret_index, .len = sizeof(secret_index) }, // Send the secret index as input
    };
    psa_outvec out_vec[] = {    // Output vector: buffer to receive data from the secure service
        { .base = p_digest, .len = digest_size }                // Digest will be written into this buffer
    };

    handle = psa_connect(TFM_DP_SECRET_DIGEST_SID,
                 TFM_DP_SECRET_DIGEST_VERSION); // Connect to Secret Digest service using its SID and version
    if (!PSA_HANDLE_IS_VALID(handle)) {         // Check if the connection handle is valid
        return PSA_ERROR_GENERIC_ERROR;         // Return error if connection fails
    }

    status = psa_call(handle, PSA_IPC_CALL, in_vec, 1,
             out_vec, 1);       // Make the IPC call: send input and receive output
    psa_close(handle);          // Close the service connection after the call

    return status;              // Return the status of the secure call
}

/* Wrapper for Jasmine Service */
psa_status_t dp_jas_hi(char *buffer, size_t buf_size)
{
    psa_status_t status;        // Variable to store the result of PSA calls
    psa_handle_t handle;        // Handle used to connect to a secure service
    psa_outvec out_vec[] = {    // Output vector: buffer to receive data from the secure service
        { .base = buffer, .len = buf_size }                     // Response will be written into this buffer
    };

    handle = psa_connect(TFM_JAS_HI_SERVICE_SID,
                         TFM_JAS_HI_SERVICE_VERSION); // Connect to Jasmine service using its SID and version
    if (!PSA_HANDLE_IS_VALID(handle)) {              // Check if the connection handle is valid
        return PSA_ERROR_GENERIC_ERROR;              // Return error if connection fails
    }

    status = psa_call(handle, PSA_IPC_CALL, NULL, 0, out_vec, 1); // Make the IPC call: no input, only output
    psa_close(handle);          // Close the service connection after the call

    return status;              // Return the status of the secure call
}


//adding more than one pirvate key

// -------------------- BLE ECDH Wrapper --------------------
// psa_status_t dp_ble_ecdh(const uint8_t remote_pub[TFN_PUBKEY_EXPORT_LEN],
//                          uint8_t *dhkey_out, size_t dhkey_size)
// {

//     if (!remote_pub || !dhkey_out) {
//         return PSA_ERROR_INVALID_ARGUMENT;
//     }

//     psa_status_t status;
//     psa_handle_t handle;
    

//     psa_invec in_vec[] = { 
//         { .base = (void *)remote_pub, .len = TFN_PUBKEY_EXPORT_LEN } 
//     };
//     psa_outvec out_vec[] = { 
//         { .base = dhkey_out, .len = dhkey_size } 
//     };

//     handle = psa_connect(TFM_BLE_ECDH_SERVICE_SID,
//                          TFM_BLE_ECDH_SERVICE_VERSION);
//     if (!PSA_HANDLE_IS_VALID(handle)) {
//         return PSA_ERROR_GENERIC_ERROR;
//     }

//     status = psa_call(handle, PSA_IPC_CALL, in_vec, 1, out_vec, 1);

     
//     psa_close(handle);

//     return status;
// }
//adding more than one private key

struct ecdh_input {
      psa_key_id_t private_key_id;
      uint8_t remote_pub[65];  // TFN_PUBKEY_EXPORT_LEN
  };

  psa_status_t dp_ble_ecdh(psa_key_id_t private_key_id,
                           const uint8_t remote_pub[65],
                           uint8_t *dhkey_out,
                           size_t dhkey_size)
  {
      if (!remote_pub || !dhkey_out) {
          return PSA_ERROR_INVALID_ARGUMENT;
      }

      psa_status_t status;
      psa_handle_t handle;

      struct ecdh_input input = {
          .private_key_id = private_key_id
      };
      memcpy(input.remote_pub, remote_pub, 65);

      psa_invec in_vec[] = {
          { .base = &input, .len = sizeof(input) }
      };
      psa_outvec out_vec[] = {
          { .base = dhkey_out, .len = dhkey_size }
      };

      handle = psa_connect(TFM_BLE_ECDH_SERVICE_SID,
                           TFM_BLE_ECDH_SERVICE_VERSION);
      if (!PSA_HANDLE_IS_VALID(handle)) {
          return PSA_ERROR_GENERIC_ERROR;
      }

      status = psa_call(handle, PSA_IPC_CALL, in_vec, 1, out_vec, 1);
      psa_close(handle);

      return status;
  }

// F5 input structure (must match secure partition)
struct f5_input_ns {
    uint32_t dh_key_id;
    uint8_t n1[16];
    uint8_t n2[16];
    uint8_t a1[7];
    uint8_t a2[7];
};

psa_status_t dp_ble_f5(uint32_t dh_key_id,
                       const uint8_t n1[16],
                       const uint8_t n2[16],
                       const void *a1,
                       const void *a2)
{
    psa_status_t status;
    psa_handle_t handle;
    struct f5_input_ns input;

    // Prepare input structure
    input.dh_key_id = dh_key_id;
    memcpy(input.n1, n1, 16);
    memcpy(input.n2, n2, 16);
    memcpy(input.a1, a1, 7);  // bt_addr_le_t is 7 bytes
    memcpy(input.a2, a2, 7);

    psa_invec in_vec[] = {
        { .base = &input, .len = sizeof(input) }
    };
    // No output - MacKey and LTK stay in secure partition

    handle = psa_connect(TFM_BLE_F5_SERVICE_SID,
                         TFM_BLE_F5_SERVICE_VERSION);
    if (!PSA_HANDLE_IS_VALID(handle)) {
        return PSA_ERROR_GENERIC_ERROR;
    }

    // Only input, no output (keys stored in secure world)
    status = psa_call(handle, PSA_IPC_CALL, in_vec, 1, NULL, 0);
    psa_close(handle);

    return status;
}

// F6 input structure (must match secure partition)
struct f6_input_ns {
    uint32_t dh_key_id;
    uint8_t n1[16];
    uint8_t n2[16];
    uint8_t r[16];
    uint8_t iocap[3];
    uint8_t a1[7];
    uint8_t a2[7];
};

psa_status_t dp_ble_f6(uint32_t dh_key_id,
                       const uint8_t n1[16],
                       const uint8_t n2[16],
                       const uint8_t r[16],
                       const uint8_t iocap[3],
                       const void *a1,
                       const void *a2,
                       uint8_t *check_out)
{
    psa_status_t status;
    psa_handle_t handle;
    struct f6_input_ns input;

    // Prepare input structure
    input.dh_key_id = dh_key_id;
    memcpy(input.n1, n1, 16);
    memcpy(input.n2, n2, 16);
    memcpy(input.r, r, 16);
    memcpy(input.iocap, iocap, 3);
    memcpy(input.a1, a1, 7);  // bt_addr_le_t is 7 bytes
    memcpy(input.a2, a2, 7);

    psa_invec in_vec[] = {
        { .base = &input, .len = sizeof(input) }
    };

    psa_outvec out_vec[] = {
        { .base = check_out, .len = 16 }  // F6 returns 16-byte check value
    };

    handle = psa_connect(TFM_BLE_F6_SERVICE_SID,
                         TFM_BLE_F6_SERVICE_VERSION);
    if (!PSA_HANDLE_IS_VALID(handle)) {
        return PSA_ERROR_GENERIC_ERROR;
    }

    // Send input, get check value output (MacKey stays in secure world)
    status = psa_call(handle, PSA_IPC_CALL, in_vec, 1, out_vec, 1);
    psa_close(handle);

    return status;
}

// GET_LTK input structure (must match secure partition)
struct get_ltk_input_ns {
    uint32_t dh_key_id;
};

psa_status_t dp_ble_get_ltk(uint32_t dh_key_id, uint8_t *ltk_out)
{
    psa_status_t status;
    psa_handle_t handle;
    struct get_ltk_input_ns input;

    // Prepare input structure
    input.dh_key_id = dh_key_id;

    psa_invec in_vec[] = {
        { .base = &input, .len = sizeof(input) }
    };

    psa_outvec out_vec[] = {
        { .base = ltk_out, .len = 16 }  // Retrieve 16-byte LTK
    };

    handle = psa_connect(TFM_BLE_GET_LTK_SERVICE_SID,
                         TFM_BLE_GET_LTK_SERVICE_VERSION);
    if (!PSA_HANDLE_IS_VALID(handle)) {
        return PSA_ERROR_GENERIC_ERROR;
    }

    // Send slot index, get LTK output
    status = psa_call(handle, PSA_IPC_CALL, in_vec, 1, out_vec, 1);
    psa_close(handle);

    return status;
}

//until here for adding more than one private key


#else
/* Fallback if CONFIG_TFM_IPC not defined */ // This block is compiled if IPC is disabled
#endif
```

## src/BLE_partition.h
```c
// /*
//  * Copyright (c) 2021 Nordic Semiconductor ASA.
//  *
//  * SPDX-License-Identifier: Apache-2.0
//  */

// //  psa_status_t dp_secret_digest(uint32_t secret_index,
// //     void *p_digest,
// //     size_t digest_size);



// // #ifndef DUMMY_PARTITION_H
// // #define DUMMY_PARTITION_H

// // #include <psa/client.h>
// // #include <stddef.h>
// // #include <stdint.h>

// // /* Existing function */
// // psa_status_t dp_secret_digest(uint32_t secret_index,
// //     void *p_digest,
// //     size_t digest_size);

// // /* New Jasmine function prototype */
// // psa_status_t dp_jas_hi(char *hi_msg, size_t msg_size);

// // #endif /* DUMMY_PARTITION_H */


// #ifndef DUMMY_PARTITION_H
// #define DUMMY_PARTITION_H

// #include <psa/client.h>
// #include <stddef.h>
// #include <stdint.h>
// #include "/home/jasmine/zephyrproject/zephyr/subsys/bluetooth/host/ecc.h"  // for BT_PUB_KEY_LEN and BT_DH_KEY_LEN
// #define TFN_PUBKEY_EXPORT_LEN 65
// #define TFN_ECDH_SHARED_KEY_LEN 32
// #include "psa/crypto.h"



// /* Existing function */
// psa_status_t dp_secret_digest(uint32_t secret_index,
//     void *p_digest,
//     size_t digest_size);

// /* New Jasmine function prototype */
// psa_status_t dp_jas_hi(char *hi_msg, size_t msg_size);

// //adding more tahn one private key
// /* BLE Keygen service prototype */
// // psa_status_t dp_ble_keygen(uint8_t *pub_key,
// //     size_t key_size,
// //     size_t *actual_export_len);

// // psa_status_t dp_ble_ecdh(const uint8_t remote_pub[TFN_PUBKEY_EXPORT_LEN],
// //                          uint8_t *dhkey_out, size_t dhkey_len);
// //adding more than one private key


//  /* BLE Keygen service prototype */
//   psa_status_t dp_ble_keygen(uint8_t conn_index,
//                              uint8_t *slot_index_out,
//                              uint8_t *pub_key_out,
//                              size_t *actual_export_len);

//   psa_status_t dp_ble_ecdh(uint8_t slot_index,
//                            const uint8_t remote_pub[TFN_PUBKEY_EXPORT_LEN]);

//   psa_status_t dp_ble_f5(uint8_t slot_index,
//                          const uint8_t n1[16],
//                          const uint8_t n2[16],
//                          const void *a1,
//                          const void *a2);


//   //until here for adding more than one private key


// #endif /* DUMMY_PARTITION_H */












#ifndef DUMMY_PARTITION_H
#define DUMMY_PARTITION_H

#include <psa/client.h>
#include <stddef.h>
#include <stdint.h>
#include "/home/jasmine/zephyrproject/zephyr/subsys/bluetooth/host/ecc.h"  // for BT_PUB_KEY_LEN and BT_DH_KEY_LEN
#define TFN_PUBKEY_EXPORT_LEN 65
#define TFN_ECDH_SHARED_KEY_LEN 32
#include "psa/crypto.h"



/* Existing function */
psa_status_t dp_secret_digest(uint32_t secret_index,
    void *p_digest,
    size_t digest_size);

/* New Jasmine function prototype */
psa_status_t dp_jas_hi(char *hi_msg, size_t msg_size);

//adding more tahn one private key
/* BLE Keygen service prototype */
// psa_status_t dp_ble_keygen(uint8_t *pub_key,
//     size_t key_size,
//     size_t *actual_export_len);

// psa_status_t dp_ble_ecdh(const uint8_t remote_pub[TFN_PUBKEY_EXPORT_LEN],
//                          uint8_t *dhkey_out, size_t dhkey_len);
//adding more than one private key


 /* BLE Keygen service prototype */
  psa_status_t dp_ble_keygen(psa_key_id_t *private_key_id_out,
                             uint8_t *pub_key_out,
                             size_t *actual_export_len);

  psa_status_t dp_ble_ecdh(psa_key_id_t private_key_id,
                           const uint8_t remote_pub[TFN_PUBKEY_EXPORT_LEN],
                           uint8_t *dhkey_out,
                           size_t dhkey_len);

  psa_status_t dp_ble_f5(uint32_t dh_key_id,
                         const uint8_t n1[16],
                         const uint8_t n2[16],
                         const void *a1,
                         const void *a2);

  psa_status_t dp_ble_f6(uint32_t dh_key_id,
                         const uint8_t n1[16],
                         const uint8_t n2[16],
                         const uint8_t r[16],
                         const uint8_t iocap[3],
                         const void *a1,
                         const void *a2,
                         uint8_t *check_out);

  psa_status_t dp_ble_get_ltk(uint32_t dh_key_id, uint8_t *ltk_out);

  //until here for adding more than one private key


#endif /* DUMMY_PARTITION_H */
```

## src/dummy_partition.c
```c
/*
 * Copyright (c) 2021 Nordic Semiconductor ASA.
 *
 * SPDX-License-Identifier: Apache-2.0
 */

 #include <tfm_ns_interface.h>

 #include "dummy_partition.h"
 
 #if defined(CONFIG_TFM_IPC)
 #include "psa/client.h"
 #include "psa_manifest/sid.h"
 
 psa_status_t dp_secret_digest(uint32_t secret_index,
             void *p_digest,
             size_t digest_size)
 {
     psa_status_t status;
     psa_handle_t handle;
 
     psa_invec in_vec[] = {
         { .base = &secret_index, .len = sizeof(secret_index) },
     };
 
     psa_outvec out_vec[] = {
         { .base = p_digest, .len = digest_size }
     };
 
     handle = psa_connect(TFM_DP_SECRET_DIGEST_SID,
                 TFM_DP_SECRET_DIGEST_VERSION);
     if (!PSA_HANDLE_IS_VALID(handle)) {
         return PSA_ERROR_GENERIC_ERROR;
     }
 
     status = psa_call(handle, PSA_IPC_CALL, in_vec, IOVEC_LEN(in_vec),
             out_vec, IOVEC_LEN(out_vec));
 
     psa_close(handle);
 
     return status;
 }
 #else /* defined(CONFIG_TFM_IPC) */
 psa_status_t dp_secret_digest(uint32_t secret_index,
             void *p_digest,
             size_t digest_size)
 {
     psa_status_t status;
     psa_invec in_vec[] = {
         { .base = &secret_index, .len = sizeof(secret_index) },
     };
 
     psa_outvec out_vec[] = {
         { .base = p_digest, .len = digest_size }
     };
 
     status = tfm_ns_interface_dispatch(
                 (veneer_fn)tfm_dp_secret_digest_req_veneer,
                 (uint32_t)in_vec,  IOVEC_LEN(in_vec),
                 (uint32_t)out_vec, IOVEC_LEN(out_vec));
 
     return status;
 }
 #endif /* defined(CONFIG_TFM_IPC) */
 
```

## src/dummy_partition.h
```c
/*
 * Copyright (c) 2021 Nordic Semiconductor ASA.
 *
 * SPDX-License-Identifier: Apache-2.0
 */

 psa_status_t dp_secret_digest(uint32_t secret_index,
    void *p_digest,
    size_t digest_size);
```
